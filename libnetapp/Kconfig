## libnetapp/Kconfig
```kconfig
#
# For a description of the syntax of this configuration file,
# see misc/tools/kconfig-language.txt.
#

comment "Networking Utilities"


source "libnetapp/dhcpc/Kconfig"
source "libnetapp/dhcpd/Kconfig"
source "libnetapp/ftpc/Kconfig"
source "libnetapp/ftpd/Kconfig"
source "libnetapp/dnsclient/Kconfig"
source "libnetapp/smtp/Kconfig"
source "libnetapp/telnetd/Kconfig"
source "libnetapp/tftpc/Kconfig"
source "libnetapp/thttpd/Kconfig"
source "libnetapp/webclient/Kconfig"
source "libnetapp/webserver/Kconfig"
source "libnetapp/ntpclient/Kconfig"
source "libnetapp/discover/Kconfig"
source "libnetapp/xmlrpc/Kconfig"
```

## libnetapp/dhcpc/Kconfig
```kconfig
#
# For a description of the syntax of this configuration file,
# see misc/tools/kconfig-language.txt.
#

config LIBNETAPP_DHCPC
	bool "DHCP client"
	default n
	depends on NET && NET_UDP && NET_BROADCAST
	---help---
		Enable support for the DHCP client.

if LIBNETAPP_DHCPC
endif
```

## libnetapp/dnsclient/Kconfig
```kconfig
#
# For a description of the syntax of this configuration file,
# see misc/tools/kconfig-language.txt.
#

config LIBNETAPP_DNSCLIENT
	bool "DNS Name resolution"
	default n
	depends on NET && NET_UDP
	---help---
		Enable support for the name resolution.

if LIBNETAPP_DNSCLIENT

choice
	prompt "Internet Protocol"
	default LIBNETAPP_DNSCLIENT_IPv4 if NET_IPv4
	default LIBNETAPP_DNSCLIENT_IPv6 if NET_IPv6 && !NET_IPv4

config LIBNETAPP_DNSCLIENT_IPv4
	bool "IPv4"
	depends on NET_IPv4

config LIBNETAPP_DNSCLIENT_IPv6
	bool "IPv6"
	depends on NET_IPv6

endchoice # Internet Protocol

config LIBNETAPP_DNSCLIENT_ENTRIES
	int "Number of DNS resolver entries"
	default 8
	---help---
		Number of DNS resolver entries.  Default: 8

config LIBNETAPP_DNSCLIENT_MAXRESPONSE
	int "Max response size"
	default 96
	---help---
		This setting determines the maximum size of response message that
		can be received by the DNS resolver.  The default is 96 but may
		need to be larger on enterprise networks (perhaps 176).

endif # LIBNETAPP_DNSCLIENT
```

## libnetapp/ftpd/Kconfig
```kconfig
#
# For a description of the syntax of this configuration file,
# see misc/tools/kconfig-language.txt.
#

config LIBNETAPP_FTPD
	bool "FTP server"
	default n
	---help---
		Enable support for the FTP server.

if LIBNETAPP_FTPD
endif
```

## libnetapp/ntpclient/Kconfig
```kconfig
#
# For a description of the syntax of this configuration file,
# see misc/tools/kconfig-language.txt.
#

config LIBNETAPP_NTPCLIENT
	bool "NTP client"
	default n
	depends on NET_UDP
	---help---
		Enable support for the minimal NTP client.

if LIBNETAPP_NTPCLIENT

config LIBNETAPP_NTPCLIENT_SERVERIP
	hex "NTP server IP address"
	default 0x0a000001

config LIBNETAPP_NTPCLIENT_PORTNO
	int "NTP server port number"
	default 123

config LIBNETAPP_NTPCLIENT_STACKSIZE
	int "NTP client daemon stack stack size"
	default 2048

config LIBNETAPP_NTPCLIENT_SERVERPRIO
	int "NTP client daemon priority"
	default 100

config LIBNETAPP_NTPCLIENT_POLLDELAYSEC
	int "NTP client poll interval (seconds)"
	default 60

config LIBNETAPP_NTPCLIENT_SIGWAKEUP
	int "NTP client wakeup signal number"
	default 18
	depends on !DISABLE_SIGNALS

endif # LIBNETAPP_NTPCLIENT
```

## libnetapp/smtp/Kconfig
```kconfig
#
# For a description of the syntax of this configuration file,
# see misc/tools/kconfig-language.txt.
#

config LIBNETAPP_SMTP
	bool "SMTP"
	default n
	---help---
		Enable support for SMTP.

if LIBNETAPP_SMTP
endif
```

## libnetapp/telnetd/Kconfig
```kconfig
#
# For a description of the syntax of this configuration file,
# see misc/tools/kconfig-language.txt.
#

config LIBNETAPP_TELNETD
	bool "Telet daemon"
	default n
	depends on NET && NET_TCP
	---help---
		Enable support for the Telnet daemon.

if LIBNETAPP_TELNETD
endif
```

## libnetapp/tftpc/Kconfig
```kconfig
#
# For a description of the syntax of this configuration file,
# see misc/tools/kconfig-language.txt.
#

config LIBNETAPP_TFTPC
	bool "TFTP client"
	default n
	---help---
		Enable support for the TFTP client.

if LIBNETAPP_TFTPC
endif
```

## libnetapp/xmlrpc/Kconfig
```kconfig
#
# For a description of the syntax of this configuration file,
# see misc/tools/kconfig-language.txt.
#

config LIBNETAPP_XMLRPC
	bool "XML RPC library"
	default n
	depends on NET_TCP
	select UTIL_NETLIB
	---help---
		Enables the Embeddable Lightweight XML-RPC Server discussed at
		http://www.drdobbs.com/web-development/an-embeddable-lightweight-xml-rpc-server/184405364

if LIBNETAPP_XMLRPC

config XMLRPC_STRINGSIZE
	int "Maximum string length"
	default 64
	---help---
		Maximum string length for method names and XML RPC string values.

endif
```

## util/Kconfig
```kconfig
#
# For a description of the syntax of this configuration file,
# see misc/tools/kconfig-language.txt.
#


source "util/cle/Kconfig"

source "util/inifile/Kconfig"

source "util/readline/Kconfig"

source "util/netlib/Kconfig"

source "util/init/Kconfig"

source "util/json/Kconfig"

source "util/codecs/Kconfig"
```

## util/inifile/Kconfig
```kconfig
#
# For a description of the syntax of this configuration file,
# see misc/tools/kconfig-language.txt.
#

config UTIL_INIFILE
	bool "INI file parser"
	default n
	---help---
		Enable support for a simple INI file parser.

if UTIL_INIFILE

config UTIL_INIFILE_MAXLINE
	int "Max line length"
	default 256
	---help---
		The largest line that the parser can expect to see in an INI file.

config UTIL_INIFILE_DEBUGLEVEL
	int "Debug level"
	default 0
	range 0 2
	---help---
		0=Debug off; 1=Print errors on console; 2=Print debug information
		on the console.

endif # UTIL_INIFILE
```

## util/netlib/Kconfig
```kconfig
#
# For a description of the syntax of this configuration file,
# see misc/tools/kconfig-language.txt.
#

config UTIL_NETLIB
	bool "Network support library"
	default n
	---help---
		Enable support for the network support library.
```
